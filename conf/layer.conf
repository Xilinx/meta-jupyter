## conf/layer.conf
```bitbake
# We have a conf and classes directory, add to BBPATH
BBPATH .= ":${LAYERDIR}"

# We have a packages directory, add to BBFILES
BBFILES += "\
	${LAYERDIR}/recipes-*/*.bb \
	${LAYERDIR}/recipes-*/*.bbappend \
	${LAYERDIR}/recipes-*/*/*.bb \
	${LAYERDIR}/recipes-*/*/*.bbappend \
"

BBFILE_COLLECTIONS += "jupyter-layer"
BBFILE_PATTERN_jupyter-layer = "^${LAYERDIR}/"
BBFILE_PRIORITY_jupyter-layer = "7"

BBFILES_DYNAMIC += " \
    qt6-layer:${LAYERDIR}/dynamic-layers/qt6-layer/recipes-*/*.bbappend \
    qt6-layer:${LAYERDIR}/dynamic-layers/qt6-layer/recipes-*/*/*.bbappend \
"

LAYERDEPENDS_jupyter-layer = "core meta-python"

LAYERSERIES_COMPAT_jupyter-layer = "wrynose"
```
